## conf/layer.conf
```bitbake
# We have a conf and classes directory, add to BBPATH
BBPATH := "${BBPATH}:${LAYERDIR}"

# We have a packages directory, add to BBFILES
BBFILES := "${BBFILES} ${LAYERDIR}/recipes-*/*/*.bb"
BBFILES += " ${LAYERDIR}/recipes-*/*/*.bbappend"

BBFILE_COLLECTIONS += "parallella"
BBFILE_PATTERN_parallella := "^${LAYERDIR}/"
BBFILE_PRIORITY_parallella = "8"
```

## conf/machine/include/parallella-common.inc
```bitbake
DEFAULTTUNE = "armv7ahf-neon"

PREFERRED_PROVIDER_virtual/kernel ?= "linux-parallella"

require conf/machine/include/tune-zynq.inc
require conf/machine/include/machine-xilinx-default.inc

SERIAL_CONSOLE = "115200 ttyPS0"
```

## conf/machine/parallella-16-gen0.conf
```bitbake
#@TYPE: Machine
#@NAME: parallella-16-gen0
#@DESCRIPTION: Adapteva Parallella-16 Board (gen 0)

require conf/machine/include/tune-zynq.inc
require conf/machine/include/machine-xilinx-default.inc

SERIAL_CONSOLE = "115200 ttyPS0"

MACHINE_DEVICETREE := "parallella/parallella-16-gen0.dts"
```

## conf/machine/parallella-hdmi.conf
```bitbake
#@TYPE: Machine
#@NAME: parallella1-hdmi
#@DESCRIPTION: Adapteva Parallella Board with hdmi support

require conf/machine/include/parallella-common.inc

EXTRA_IMAGEDEPENDS += "parallella-hdmi-bitstream"

KERNEL_DEVICETREE = "zynq-parallella.dtb"
```

## conf/machine/parallella.conf
```bitbake
#@TYPE: Machine
#@NAME: parallella
#@DESCRIPTION: Adapteva Parallella Board headless

require conf/machine/include/parallella-common.inc

EXTRA_IMAGEDEPENDS += "parallella-bitstream"

KERNEL_DEVICETREE = "zynq-parallella-headless.dtb"
```
